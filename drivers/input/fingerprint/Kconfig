## drivers/input/fingerprint/Kconfig
```kconfig
#
#Fingerprint
#

config MTK_FINGERPRINT
	tristate "Mediatek Fingerprint"
	default n
	---help---

source "drivers/input/fingerprint/gfx1xm/Kconfig"
source "drivers/input/fingerprint/et320/Kconfig"
```

## drivers/input/touchscreen/mediatek/GT9XX_GESTURE/Kconfig
```kconfig
#
# Touchscreen driver configuration
#
if TOUCHSCREEN_MTK_GT9XX_GESTURE

config TPD_ROTATE_90
	bool "GT9XX_GESTURE for Mediatek package"
	default n
	help
	Say Y here if you have GT9XX_GESTURE touch panel TPD_ROTATE_90.

	If unsure, say N.

	To compile this dirver as a module, choose M here: the
	module will be called.

config TPD_ROTATE_180
	bool "GT9XX_GESTURE for Mediatek package"
	default n
	help
	Say Y here if you have GT9XX_GESTURE touch panel TPD_ROTATE_180.

	If unsure, say N.

	To compile this dirver as a module, choose M here: the
	module will be called.

config TPD_ROTATE_270
	bool "GT9XX_GESTURE for Mediatek package"
	default n
	help
	Say Y here if you have GT9XX_GESTURE touch panel TPD_ROTATE_270.

	If unsure, say N.

	To compile this dirver as a module, choose M here: the
	module will be called.

endif
```

## drivers/misc/mediatek/accelerometer/KXTJ2_1009/Kconfig
```kconfig
config MTK_KXTJ2_1009
        bool "MTK_KXTJ2_1009 for MediaTek package"
        default n
	help
	  It support different accelerometer sensor.
          If this option is set,
	  it will support
          MTK_KXTJ2_1009 Accelerometer.
```

## drivers/misc/mediatek/gyroscope/lsm6ds3gy/Kconfig
```kconfig
config MTK_LSM6DS3GY
        bool "MTK_LSM6DS3GY for MediaTek package"
        default n
	help
        It support different gyroscope sensor.
        If this option is set,
	  	it will support
         MTK_LSM6DS3GY gyroscope.
```

## drivers/misc/mediatek/iraf/Kconfig
```kconfig
config CUSTOM_KERNEL_IRAF
	bool "CUSTOM_KERNEL_IRAF"
	help
	  IRAF sensor driver to detect ambient light and the object is close
	  or far awary from device. After configure this configuration,
          the specific ambient light and proximity sensor driver configuration
          should be configured as well.

config MTK_AUTO_DETECT_IRAF
	bool "MTK_AUTO_DETECT_IRAF"
	help
	  This feature Option is used for projects which using more than one
	  IRAF sensors, more than one IRAF drivers can be builded in to
	  project and be auto detected by setting this option to yes,
          usually only one IRAF driver can be probed.

source "drivers/misc/mediatek/iraf/VL6180/Kconfig"
```

## drivers/misc/mediatek/magnetometer/mmc3524x/Kconfig
```kconfig
config MTK_MMC3524X
	bool "MMC3524X for MediaTek package"
	default n
	help
	  It support different magnetometer sensor.
          If this option is set,
	  it will support
          MMC3524X magnetometer.
```

## drivers/misc/mediatek/magnetometer/st480/Kconfig
```kconfig
config MTK_ST480
	bool "ST480 for MediaTek package"
	default n
	help
	  It support different magnetometer sensor.
          If this option is set,
	  it will support
          ST480 magnetometer.
```

## drivers/misc/mediatek/snled/Kconfig
```kconfig
config CUSTOM_KERNEL_SNLED
	bool "CUSTOM_KERNEL_SNLED"
	help
	  SN sensor driver to detect ambient light and the object is close
	  or far awary from device. After configure this configuration,
          the specific ambient light and proximity sensor driver configuration
          should be configured as well.

source "drivers/misc/mediatek/snled/SN3191/Kconfig"
```
